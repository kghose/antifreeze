## src/main/Kconfig.projbuild
```kconfig
menu "Antifreeze Config"

    config WIFI_SSID
        string "WiFi SSID"
        help
            SSID (network name).

    config WIFI_PASSWORD
        string "WiFi Password"
        help
            WiFi password (WPA or WPA2).


    config WIFI_CONNECT_MAXIMUM_RETRY
        int "Max retries"
        default 3
        help
            Number of retries to connect to router.

    config TEST_MODE
        bool "Test mode"
        help
            Compile device in test mode.
            If temperature sensor is missing 
            run a simulated temperature probe.
            Shorten sample times and relay cycles 
            so testing is quicker.

endmenu
```
